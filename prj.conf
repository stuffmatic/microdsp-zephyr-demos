## CMakeLists.txt
```
# SPDX-License-Identifier: Apache-2.0

cmake_minimum_required(VERSION 3.20.0)
find_package(Zephyr REQUIRED HINTS $ENV{ZEPHYR_BASE})
project(rust_audio_demo)

target_sources(app PRIVATE src/main.c src/i2s.c src/leds.c src/buttons.c src/codecs/wm8904.c)

# Import the zephyr_add_rust_library function
include(zephyr_add_rust_library.cmake)

# Add microdsp-demos crate dependency.
zephyr_add_rust_library(
  CRATE_NAME microdsp-demos # Crate name as specified in Cargo.toml
  CRATE_DIR ${CMAKE_CURRENT_SOURCE_DIR}/microdsp_demos # Crate root dir
  CRATE_HEADER_DIR ${CMAKE_CURRENT_SOURCE_DIR}/microdsp_demos/include # C header dir
  CARGO_PROFILE release
  EXTRA_CARGO_ARGS --no-default-features --features nlms_demo # Select demo to build
)
```

## Kconfig
```
source "Kconfig.zephyr"

config AUDIO_CODEC_WM8758
  bool "Use WM8758 audio codec"
  default n

config AUDIO_CODEC_WM8904
  bool "Use WM8904 audio codec"
  default n
```

## prj.conf
```kconfig
CONFIG_GPIO=y
CONFIG_DEBUG_OPTIMIZATIONS=y
CONFIG_DEBUG_THREAD_INFO=y
CONFIG_I2C=y
CONFIG_ASSERT=y
CONFIG_MINIMAL_LIBC_MALLOC=y
CONFIG_MINIMAL_LIBC_MALLOC_ARENA_SIZE=240000
CONFIG_RING_BUFFER=y
CONFIG_FPU=y
CONFIG_NRFX_I2S=y
# TODO only in dev builds
CONFIG_MAIN_STACK_SIZE=2048
```

## nrf52840dk_nrf52840.overlay
```dts
// To get started, press Ctrl+Space (or Option+Esc) to bring up the completion menu and view the available nodes.

// You can also use the buttons in the sidebar to perform actions on nodes.
// Actions currently available include:

// * Enabling / disabling the node
// * Adding the bus to a bus
// * Removing the node
// * Connecting ADC channels

// For more help, browse the DeviceTree documentation at https://docs.zephyrproject.org/latest/guides/dts/index.html
// You can also visit the nRF DeviceTree extension documentation at https://nrfconnect.github.io/vscode-nrf-connect/devicetree/nrfdevicetree.html

&pinctrl {
  i2c0_default: i2c0_default {
  group1 {
    psels = <NRF_PSEL(TWIM_SDA, 0, 26)>,
      <NRF_PSEL(TWIM_SCL, 0, 27)>;
          bias-pull-up; // <- needed to get i2c to work
  };
};
};
```

## nrf5340dk_nrf5340_cpuapp_ns.overlay
```dts
// To get started, press Ctrl+Space (or Option+Esc) to bring up the completion menu and view the available nodes.

// You can also use the buttons in the sidebar to perform actions on nodes.
// Actions currently available include:

// * Enabling / disabling the node
// * Adding the bus to a bus
// * Removing the node
// * Connecting ADC channels

// For more help, browse the DeviceTree documentation at https: //docs.zephyrproject.org/latest/guides/dts/index.html
// You can also visit the nRF DeviceTree extension documentation at https: //nrfconnect.github.io/vscode-nrf-connect/devicetree/nrfdevicetree.html

&pinctrl {
  i2c1_default: i2c1_default {
    group1 {
      psels = <NRF_PSEL(TWIM_SDA, 1, 2)>,
              <NRF_PSEL(TWIM_SCL, 1, 3)>;
      bias-pull-up; // <- needed to get i2c to work
    };
  };
};
```

## src/main.c
```c
#include <zephyr/zephyr.h>
#include <zephyr/drivers/gpio.h>
#include <sys/ring_buffer.h>
#include <microdsp_demos/microdsp_demos.h>
#include <stdlib.h>

#include "audio_callbacks.h"
#include "buttons.h"
#include "i2s.h"
#include "leds.h"
#include "codecs/wm8904.h"

#ifdef CONFIG_SOC_SERIES_NRF53X
static i2s_pin_cfg_t i2s_pin_cfg = {
    .sck_pin = 25,
    .lrck_pin = 7,
    .sdin_pin = 6,
    .sdout_pin = 5,
    .mck_pin = 26
};
#endif

#ifdef CONFIG_SOC_SERIES_NRF52X
static i2s_pin_cfg_t i2s_pin_cfg = {
    .sck_pin = 30,
    .lrck_pin = 29,
    .sdin_pin = 4,
    .sdout_pin = 28,
    .mck_pin = 31,
};
#endif

#define APP_MSG_BUFFER_SIZE 64
typedef struct
{
    void *rust_app_ptr;
    uint8_t msg_rx_buffer[APP_MSG_BUFFER_SIZE];
    uint8_t msg_tx_buffer[APP_MSG_BUFFER_SIZE];
    struct ring_buf msg_rx; /* to rust app */
    struct ring_buf msg_tx; /* from rust app */
} demo_app_t;

static demo_app_t demo_app;

static void processing_cb(void *cb_data, uint32_t sample_count, float *tx, const float *rx)
{
    demo_app_t *demo_app = (demo_app_t *)cb_data;

    /* Pass incoming messages to the demo app */
    uint8_t command = 0;
    while (ring_buf_get(&demo_app->msg_rx, &command, 1) > 0)
    {
        demo_app_handle_message(demo_app->rust_app_ptr, command);
    }

    /* Process audio */
    demo_app_process(demo_app->rust_app_ptr, tx, rx, sample_count);

    /* Debug listen to mic signal */
    if (false)
    {
        for (int i = 0; i < sample_count; i++)
        {
            tx[i] = 0.5 * rx[i];
        }
    }

    /* Pass outgoing messages to the main loop */
    while (true) {
        app_message_t message = demo_app_next_outgoing_message(demo_app->rust_app_ptr);
        if (message == 0) {
            break;
        } else {
            ring_buf_put(&demo_app->msg_tx, &message, 1);
        }
    }
}

static void dropout_cb(void *data)
{
    printk("dropout!\n");
}

void button_callback(int btn_idx) {
    uint8_t msg = 0;

    switch (btn_idx) {
        case 0:
            msg = Button0Down;
            break;
        case 1:
            msg = Button1Down;
            break;
        case 2:
            msg = Button2Down;
            break;
        case 3:
            msg = Button3Down;
            break;
    }

    if (msg) {
        ring_buf_put(&demo_app.msg_rx, &msg, 1);
    }
}

void main(void)
{
    /* Determined by NRF_I2S_MCK_32MDIV... and NRF_I2S_RATIO_... */
    float sample_rate = 44444.444;

    /* LEDs and buttons  */
    init_leds();
    init_buttons(&button_callback);

    /* Create demo app */
    demo_app.rust_app_ptr = demo_app_create(sample_rate);

    /* Create ring buffers for sending messages to and from the demo app */
    ring_buf_init(&demo_app.msg_rx, ARRAY_SIZE(demo_app.msg_rx_buffer), demo_app.msg_rx_buffer);
    ring_buf_init(&demo_app.msg_tx, ARRAY_SIZE(demo_app.msg_tx_buffer), demo_app.msg_tx_buffer);

    /* Init audio codec  */
    wm8904_init();

    /* Start I2S  */
    audio_callbacks_t audio_callbacks = {
        .dropout_cb = dropout_cb,
        .processing_cb = processing_cb,
        .cb_data = &demo_app,
    };
    i2s_start(&i2s_pin_cfg, &audio_callbacks);

    /* Main loop. Poll and react to messages from the rust app. */
    int32_t poll_interval_ms = 10;
    while (1)
    {
        uint8_t command = 0;
        while (ring_buf_get(&demo_app.msg_tx, &command, 1) > 0)
        {
            switch (command)
            {
            case Led0On:
                set_led_state(0, 1);
                break;
            case Led0Off:
                set_led_state(0, 0);
                break;
            case Led1On:
                set_led_state(1, 1);
                break;
            case Led1Off:
                set_led_state(1, 0);
                break;
            case Led2On:
                set_led_state(2, 1);
                break;
            case Led2Off:
                set_led_state(2, 0);
                break;
            case Led3On:
                set_led_state(3, 1);
                break;
            case Led3Off:
                set_led_state(3, 0);
                break;
            default:
                break;
            }
        }
        k_msleep(poll_interval_ms);
    }
}
```

## src/audio_callbacks.h
```c
#ifndef AUDIO_CALLBACKS_H
#define AUDIO_CALLBACKS_H

typedef void (*audio_processing_callback_t)(
  void* cb_data,
  unsigned int sample_count,
  float* tx,
  const float* rx
);
typedef void (*audio_dropout_callback_t)(void* cb_data);

typedef struct {
  audio_processing_callback_t processing_cb;
  audio_dropout_callback_t dropout_cb;
  void* cb_data;
} audio_callbacks_t;

#endif
```

## src/audio_cfg.h
```c
#ifndef AUDIO_CFG_H
#define AUDIO_CFG_H

#include <nrfx_i2s.h>
#include "codecs/wm8758.h"
#include "codecs/wm8904.h"

typedef struct {
    void (*init_codec)();
    float sample_rate;

    // nrfx i2s pins
    uint8_t sck_pin;
    uint8_t lrck_pin;
    uint8_t mck_pin;
    uint8_t sdout_pin;
    uint8_t sdin_pin;

    // nrfx i2s clock setup
    nrf_i2s_mck_t mck_setup;
    nrf_i2s_ratio_t ratio;
} audio_cfg_t;

static void init_codec() {
    #ifdef CONFIG_AUDIO_CODEC_WM8758
    #ifdef CONFIG_SOC_SERIES_NRF52X
    wm8758 codec is not supported on nrf52x
    #endif
    wm8758_init();
    #endif
    #ifdef CONFIG_AUDIO_CODEC_WM8904
    wm8904_init();
    #endif
}

#ifdef CONFIG_SOC_SERIES_NRF53X
static audio_cfg_t audio_cfg = {
    .init_codec = init_codec,
    .sample_rate = 44444.444,

    .sck_pin = 25,
    .lrck_pin = 7,
    .sdin_pin = 6,
    .sdout_pin = 5,
    .mck_pin = 26,

    .mck_setup = NRF_I2S_MCK_32MDIV15,
    .ratio = NRF_I2S_RATIO_48X
};
#endif

#ifdef CONFIG_SOC_SERIES_NRF52X
static audio_cfg_t audio_cfg = {
    .init_codec = init_codec,
    .sample_rate = 44444.444,

    .sck_pin = 30,
    .lrck_pin = 29,
    .sdin_pin = 4,
    .sdout_pin = 28,
    .mck_pin = 31,

    .mck_setup = NRF_I2S_MCK_32MDIV15,
    .ratio = NRF_I2S_RATIO_48X
};
#endif

#endif // AUDIO_CFG_H
```

## src/audio_processing.h
```c
#ifndef AUDIO_H
#define AUDIO_H

typedef void (*audio_processing_callback_t)(
  void* cb_data,
  uint32_t frame_count,
  uint32_t channel_count,
  float* tx,
  const float* rx
);
typedef void (*dropout_callback_t)(void* cb_data);

typedef struct {
  audio_processing_callback_t processing_cb;
  void* processing_cb_data;
  dropout_callback_t dropout_cb;
} audio_processing_options_t;

#endif
```

## src/buttons.c
```c
#include "buttons.h"

#include <zephyr/drivers/gpio.h>

#define BUTTON_COUNT 4
static const struct gpio_dt_spec buttons[BUTTON_COUNT] = {
    GPIO_DT_SPEC_GET_OR(DT_ALIAS(sw0), gpios, {0}),
    GPIO_DT_SPEC_GET_OR(DT_ALIAS(sw1), gpios, {0}),
    GPIO_DT_SPEC_GET_OR(DT_ALIAS(sw2), gpios, {0}),
    GPIO_DT_SPEC_GET_OR(DT_ALIAS(sw3), gpios, {0})};
static struct gpio_callback button_cb_data;
static button_callback_t button_callback = NULL;
void button_pressed(const struct device *dev, struct gpio_callback *cb,
                    uint32_t pins)
{
    for (int i = 0; i < BUTTON_COUNT; i++)
    {
        if ((pins & BIT(buttons[i].pin)) != 0)
        {
            if (button_callback) {
                button_callback(i);
            }
        }
    }
}

void init_buttons(button_callback_t cb)
{
    for (int i = 0; i < BUTTON_COUNT; i++)
    {
        __ASSERT_NO_MSG(device_is_ready(buttons[i].port));
        int ret = gpio_pin_configure_dt(&buttons[i], GPIO_INPUT);
        __ASSERT_NO_MSG(ret == 0);
        ret = gpio_pin_interrupt_configure_dt(&buttons[i], GPIO_INT_EDGE_TO_ACTIVE);
        __ASSERT_NO_MSG(ret == 0);
    }
    gpio_init_callback(
        &button_cb_data,
        button_pressed,
        BIT(buttons[0].pin) | BIT(buttons[1].pin) | BIT(buttons[2].pin) | BIT(buttons[3].pin));
    int ret = gpio_add_callback(buttons[0].port, &button_cb_data);
    __ASSERT_NO_MSG(ret == 0);

    button_callback = cb;
}
```

## src/buttons.h
```c
#ifndef BUTTONS_H
#define BUTTONS_H

typedef void (*button_callback_t)(int btn_idx);
void init_buttons(button_callback_t cb);

#endif
```

## src/codec.c
```c
#include "codec.h"
#include <zephyr/drivers/i2c.h>

#define WM8758B_ADDRESS 0b11010
#define WM8904_ADDRESS 0b11010
#define I2C_NODE DT_NODELABEL(i2c0)
static const struct device *i2c_dev = DEVICE_DT_GET(I2C_NODE);

struct register_write
{
    uint16_t addr;
    uint16_t data;
};

int write_reg(uint8_t device_addr, uint16_t reg_addr, uint16_t data)
{
    __ASSERT(reg_addr <= 0x7f, "invalid codec register address"); // 7 bit register address
    __ASSERT(reg_addr <= 0x1ff, "invalid codec register data");   // 9 bit register data
    const uint16_t reg_and_address = (reg_addr << 9) | data;

    uint8_t payload[2] = {
        (reg_and_address & 0xff) >> 8, // msb
        (reg_and_address >> 0) & 0xff  // lsb
    };
    int write_rc = i2c_write(i2c_dev, payload, 2, device_addr);
    printk("write_reg result %d\n", write_rc);
    return write_rc;
}

uint32_t wm8904_read_reg(uint8_t reg_addr)
{
    uint8_t write_buf[1] = { reg_addr };
    uint8_t read_buf[2] = { 0, 0 };
    int read_rc = i2c_write_read(i2c_dev, WM8904_ADDRESS, write_buf, 1, read_buf, 2);
    printk("read_reg result %d\n", read_rc);
    uint32_t result = ((read_buf[0] << 8) & 0xff00) | read_buf[1];
    return result;
}

int wm8904_write_reg(uint8_t reg_addr, uint16_t data)
{
    uint8_t write_buf[3] = {
        reg_addr,
        (data & 0xff00) >> 8, // msb
        data & 0xff  // lsb
    };
    uint8_t read_buf[2] = { 0, 0 };
    // int write_rc = i2c_write(i2c_dev, payload, 3, WM8904_ADDRESS);
    int write_rc = i2c_write_read(i2c_dev, WM8904_ADDRESS, write_buf, 3, read_buf, 2);
    printk("write_reg result %d\n", write_rc);
    return write_rc;
}

void init_wm8758b_codec()
{
    if (device_is_ready(i2c_dev))
    {
        // Reset command
        write_reg(WM8758B_ADDRESS, 0, 0);
        // biascut
        write_reg(WM8758B_ADDRESS, 61, (1 << 8));

        // Set
        // PLL enable (1 << 5)
        // BIASEN "The analogue amplifiers will not operate unless BIASEN is enabled." p 76
        // The VMIDSEL and BIASEN bits must be set to enable analogue output midrail voltage and for normal DAC operation. p 24
        // (1 << 0) sets vmidsel to 01 as in the recommended startup sequence
        const int vmidsel = 1 << 0;
        const int bufioen = 1 << 2;
        const int biasen = 1 << 3;
        const int pllen = 1 << 5;
        write_reg(WM8758B_ADDRESS, 1, pllen | biasen | bufioen | vmidsel);

        // Enable OUT1 left/right
        const int adc_enable = (1 << 1) | (1 << 0);
        const int input_pga_enable = (1 << 3) | (1 << 2);
        const int boost_enable = (1 << 5) | (1 << 4);
        const int out1_enable = (1 << 8) | (1 << 7);
        write_reg(WM8758B_ADDRESS, 2, out1_enable | boost_enable | input_pga_enable | adc_enable);

        // Enable DAC left/right and left/right mixer
        const int dac_enable = (1 << 1) | (1 << 0);
        const int mixer_enable = (1 << 3) | (1 << 2);
        write_reg(WM8758B_ADDRESS, 3, mixer_enable | dac_enable);

        // 16 bit i2s format
        write_reg(WM8758B_ADDRESS, 4, 0x10);

        // companding
        // write_reg(i2c_num, 5, 0x0);

        // CLKSEL (use PLL)
        write_reg(WM8758B_ADDRESS, 6, 0b100000000); // 0x140 should be the default value

        // TODO: The following PLL values
        // are based on an actual sample rate of 41666.7
        // PLL N (10, no pre scale)
        write_reg(WM8758B_ADDRESS, 36, 0x0b);
        // PLL K (0.66666) 1, 2, 3
        write_reg(WM8758B_ADDRESS, 37, 0b10101010);
        write_reg(WM8758B_ADDRESS, 38, 0b10101010);
        write_reg(WM8758B_ADDRESS, 39, 0b10101011);

        // Set l/r dac volume
        // write_reg(WM8758B_ADDRESS, 11, 0x1ff);
        // write_reg(WM8758B_ADDRESS, 12, 0x1ff);

        // ALC
        // write_reg(i2c_num, 32, 0x0);
        // write_reg(i2c_num, 33, 0x0);
        // write_reg(i2c_num, 34, 0x0);

        // mic bypass path (for debugging mic input)
        // write_reg(i2c_num, 43, (1 << 8) | (1 << 7));

        // l/r adc digital volume
        write_reg(WM8758B_ADDRESS, 15, 0x1ff);
        write_reg(WM8758B_ADDRESS, 16, 0x1ff);

        // input PGA volume
        // write_reg(i2c_num, 44, 0x22); // loud metallic static if 0
        // write_reg(i2c_num, 45, 0x11f); // gain adjustment audible in the bypass path too
        // write_reg(i2c_num, 46, 0x11f);
        write_reg(WM8758B_ADDRESS, 44, 0x12); // loud metallic static if 0
        write_reg(WM8758B_ADDRESS, 45, 0x3f);
        write_reg(WM8758B_ADDRESS, 46, 0x3f);

        // input boost ctrl. does not seem audible in the bypass path
        const int pga_boost_enable = 1;
        write_reg(WM8758B_ADDRESS, 47, (pga_boost_enable << 8));
        write_reg(WM8758B_ADDRESS, 48, (pga_boost_enable << 8));

        // LOUT1VOL/ROUT1VOL
        write_reg(WM8758B_ADDRESS, 52, (1 << 8) | 0x39);
        write_reg(WM8758B_ADDRESS, 53, (1 << 8) | 0x39);

        // mic bypass path (for debugging mic input)
        // write_reg(WM8758B_ADDRESS, 43, (1 << 8) | (1 << 7));
    }
    else
    {
        // TODO: report error
    }
}

#define WM8904_SW_RESET_AND_ID 0x00
#define WM8904_BIAS_CONTROL_0 0x04
#define WM8904_VMID_CONTROL_0 0x05
#define WM8904_MIC_BIAS_CONTROL_0 0x06
#define WM8904_MIC_BIAS_CONTROL_1 0x07
#define WM8904_ANALOGUE_ADC_0 0x0A
#define WM8904_POWER_MANAGEMENT_0 0x0C
#define WM8904_POWER_MANAGEMENT_2 0x0E
#define WM8904_POWER_MANAGEMENT_3 0x0F
#define WM8904_POWER_MANAGEMENT_6 0x12
#define WM8904_CLOCK_RATES_0 0x14
#define WM8904_CLOCK_RATES_1 0x15
#define WM8904_CLOCK_RATES_2 0x16
#define WM8904_AUDIO_INTERFACE_0 0x18
#define WM8904_AUDIO_INTERFACE_1 0x19
#define WM8904_AUDIO_INTERFACE_2 0x1A
#define WM8904_AUDIO_INTERFACE_3 0x1B
#define WM8904_DAC_DIGITAL_VOLUME_LEFT 0x1E
#define WM8904_DAC_DIGITAL_VOLUME_RIGHT 0x1F
#define WM8904_DAC_DIGITAL_0 0x20
#define WM8904_DAC_DIGITAL_1 0x21
#define WM8904_ADC_DIGITAL_VOLUME_LEFT 0x24
#define WM8904_ADC_DIGITAL_VOLUME_RIGHT 0x25
#define WM8904_ADC_DIGITAL_0 0x26
#define WM8904_DIGITAL_MICROPHONE_0 0x27
#define WM8904_DRC_0 0x28
#define WM8904_DRC_1 0x29
#define WM8904_DRC_2 0x2A
#define WM8904_DRC_3 0x2B
#define WM8904_ANALOGUE_LEFT_INPUT_0 0x2C
#define WM8904_ANALOGUE_RIGHT_INPUT_0 0x2D
#define WM8904_ANALOGUE_LEFT_INPUT_1 0x2E
#define WM8904_ANALOGUE_RIGHT_INPUT_1 0x2F
#define WM8904_ANALOGUE_OUT1_LEFT 0x39
#define WM8904_ANALOGUE_OUT1_RIGHT 0x3A
#define WM8904_ANALOGUE_OUT2_LEFT 0x3B
#define WM8904_ANALOGUE_OUT2_RIGHT 0x3C
#define WM8904_ANALOGUE_OUT12_ZC 0x3D
#define WM8904_DC_SERVO_0 0x43
#define WM8904_DC_SERVO_1 0x44
#define WM8904_DC_SERVO_2 0x45
#define WM8904_DC_SERVO_4 0x47
#define WM8904_DC_SERVO_5 0x48
#define WM8904_DC_SERVO_6 0x49
#define WM8904_DC_SERVO_7 0x4A
#define WM8904_DC_SERVO_8 0x4B
#define WM8904_DC_SERVO_9 0x4C
#define WM8904_DC_SERVO_READBACK_0 0x4D
#define WM8904_ANALOGUE_HP_0 0x5A
#define WM8904_ANALOGUE_LINEOUT_0 0x5E
#define WM8904_CHARGE_PUMP_0 0x62
#define WM8904_CLASS_W_0 0x68
#define WM8904_WRITE_SEQUENCER_0 0x6C
#define WM8904_WRITE_SEQUENCER_1 0x6D
#define WM8904_WRITE_SEQUENCER_2 0x6E
#define WM8904_WRITE_SEQUENCER_3 0x6F
#define WM8904_WRITE_SEQUENCER_4 0x70
#define WM8904_FLL_CONTROL_1 0x74
#define WM8904_FLL_CONTROL_2 0x75
#define WM8904_FLL_CONTROL_3 0x76
#define WM8904_FLL_CONTROL_4 0x77
#define WM8904_FLL_CONTROL_5 0x78
#define WM8904_GPIO_CONTROL_1 0x79
#define WM8904_GPIO_CONTROL_2 0x7A
#define WM8904_GPIO_CONTROL_3 0x7B
#define WM8904_GPIO_CONTROL_4 0x7C
#define WM8904_DIGITAL_PULLS 0x7E
#define WM8904_INTERRUPT_STATUS 0x7F
#define WM8904_INTERRUPT_STATUS_MASK 0x80
#define WM8904_INTERRUPT_POLARITY 0x81
#define WM8904_INTERRUPT_DEBOUNCE 0x82
#define WM8904_EQ1 0x86
#define WM8904_EQ2 0x87
#define WM8904_EQ3 0x88
#define WM8904_EQ4 0x89
#define WM8904_EQ5 0x8A
#define WM8904_EQ6 0x8B
#define WM8904_EQ7 0x8C
#define WM8904_EQ8 0x8D
#define WM8904_EQ9 0x8E
#define WM8904_EQ10 0x8F
#define WM8904_EQ11 0x90
#define WM8904_EQ12 0x91
#define WM8904_EQ13 0x92
#define WM8904_EQ14 0x93
#define WM8904_EQ15 0x94
#define WM8904_EQ16 0x95
#define WM8904_EQ17 0x96
#define WM8904_EQ18 0x97
#define WM8904_EQ19 0x98
#define WM8904_EQ20 0x99
#define WM8904_EQ21 0x9A
#define WM8904_EQ22 0x9B
#define WM8904_EQ23 0x9C
#define WM8904_EQ24 0x9D
#define WM8904_CONTROL_INTERFACE_TEST_1 0xA1
#define WM8904_ADC_TEST_0 0xC6
#define WM8904_FLL_NCO_TEST_0 0xF7
#define WM8904_FLL_NCO_TEST_1 0xF8

/* void init_wm8904_codec_old()
{
    // https://github.com/avrxml/asf/blob/master/sam/components/audio/codec/wm8904/example/wm8904_example.c
    if (device_is_ready(i2c_dev))
    {
        // Reset the device, making sure CLK_SYS_ENA = 0. From the datasheet:
        // Note that, if it cannot be assured that MCLK is present when accessing
        // the register map, then it is required to set CLK_SYS_ENA = 0 to
        // ensure correct operation.
        wm8904_write_reg(WM8904_SW_RESET_AND_ID, 0);

        // Read device id to make sure the device is present
        uint32_t device_id = wm8904_read_reg(WM8904_SW_RESET_AND_ID);
        __ASSERT(device_id == 0x8904, "Failed to read wm8904 device id");

        // Perform start-up sequence
        // 0.
        int ISEL = 0b10;
        wm8904_write_reg(WM8904_BIAS_CONTROL_0, ISEL << 2);
        k_msleep(100);

        // 1.
        int VMID_BUF_ENA = 1;
        int VMID_RES = 0b11;
        int VMID_ENA = 1;
        wm8904_write_reg(WM8904_VMID_CONTROL_0, (VMID_ENA << 0) | (VMID_RES << 1) | (VMID_BUF_ENA << 6));
        k_msleep(5);

        // 2.
        VMID_RES = 0b01;
        wm8904_write_reg(WM8904_VMID_CONTROL_0, (VMID_ENA << 0) | (VMID_RES << 1) | (VMID_BUF_ENA << 6));
        k_msleep(1);

        // 3.
        wm8904_write_reg(WM8904_BIAS_CONTROL_0, (ISEL << 2) | (1 << 0));
        k_msleep(1);

        // 4.
        wm8904_write_reg(WM8904_POWER_MANAGEMENT_2, (1 << 1) | (1 << 0));
        k_msleep(1);

        // 5.
        wm8904_write_reg(WM8904_POWER_MANAGEMENT_3, (1 << 1) | (1 << 0));
        k_msleep(1);

        // 6.
        wm8904_write_reg(WM8904_CLOCK_RATES_2, (1 << 1));
        k_msleep(1);

        // 7.
        wm8904_write_reg(WM8904_POWER_MANAGEMENT_6, (1 << 3) | (1 << 2));
        k_msleep(1);

        // 10.
        wm8904_write_reg(WM8904_CHARGE_PUMP_0, (1 << 0));
        k_msleep(1);

        // 12.
        wm8904_write_reg(WM8904_ANALOGUE_HP_0, (1 << 4) | (1 << 0));
        k_msleep(1);

        // 13.
        wm8904_write_reg(WM8904_ANALOGUE_LINEOUT_0, (1 << 4) | (1 << 0));
        k_msleep(1);

        // 14.
        wm8904_write_reg(WM8904_ANALOGUE_HP_0, (1 << 5) | (1 << 4) | (1 << 1) | (1 << 0));
        k_msleep(1);

        // 15.
        wm8904_write_reg(WM8904_ANALOGUE_LINEOUT_0, (1 << 5) | (1 << 4) | (1 << 1) | (1 << 0));
        k_msleep(1);

        // 16.
        wm8904_write_reg(WM8904_DC_SERVO_0, (1 << 3) | (1 << 2) | (1 << 1) | (1 << 0));
        k_msleep(1);

        // 17.
        wm8904_write_reg(WM8904_DC_SERVO_1, (1 << 7) | (1 << 6) | (1 << 5) | (1 << 4));
        k_msleep(1);

        // 19.
        wm8904_write_reg(WM8904_ANALOGUE_HP_0, (1 << 6) | (1 << 5) | (1 << 4) | (1 << 2) | (1 << 1) | (1 << 0));
        k_msleep(1);

        // 20.
        wm8904_write_reg(WM8904_ANALOGUE_LINEOUT_0, (1 << 6) | (1 << 5) | (1 << 4) | (1 << 2) | (1 << 1) | (1 << 0));
        k_msleep(1);

        // 21.
        wm8904_write_reg(WM8904_ANALOGUE_HP_0, (1 << 7) | (1 << 6) | (1 << 5) | (1 << 4) | (1 << 3) | (1 << 2) | (1 << 1) | (1 << 0));
        k_msleep(1);

        // 22.
        wm8904_write_reg(WM8904_ANALOGUE_LINEOUT_0, (1 << 7) | (1 << 6) | (1 << 5) | (1 << 4) | (1 << 3) | (1 << 2) | (1 << 1) | (1 << 0));
        k_msleep(1);

        // Pll config
        {
            wm8904_write_reg(WM8904_FLL_CONTROL_1, 0b001); // ENABLE FLL, FRACN_ENA false
            wm8904_write_reg(WM8904_FLL_CONTROL_2, (9 << 8));
            wm8904_write_reg(WM8904_FLL_CONTROL_3, 0x0);
            wm8904_write_reg(WM8904_FLL_CONTROL_4, (72 << 5));
            wm8904_write_reg(WM8904_FLL_CONTROL_5, 0b01); // use bitclock as FLL reference

            k_msleep(5);

            // wm8904_write_register(WM8904_CLOCK_RATES_1, WM8904_CLK_SYS_RATE(3) | WM8904_SAMPLE_RATE(5));
            // wm8904_write_reg(WM8904_CLOCK_RATES_1, 0b101 | (0b11 << 10)); // sysclk = 256fs, fs =~ 44.1 khz
            // wm8904_write_register(WM8904_CLOCK_RATES_0, 0x0000);
            // wm8904_write_reg(WM8904_CLOCK_RATES_0, 0b0);
            // wm8904_write_register(WM8904_CLOCK_RATES_2,
            //           		     WM8904_SYSCLK_SRC | WM8904_CLK_SYS_ENA | WM8904_CLK_DSP_ENA);
            // wm8904_write_reg(WM8904_CLOCK_RATES_2, (1 << 1) | (1 << 14)); // sysclk src = pll, disable sysclock
            // wm8904_write_register(WM8904_AUDIO_INTERFACE_1, WM8904_BCLK_DIR | WM8904_AIF_FMT_I2S);
            const int word_len = (0b00 << 2); // 16 bit
            wm8904_write_reg(WM8904_AUDIO_INTERFACE_1, 0b10 | word_len);
        }

        // enable sysclk and set sysclk src to to fll
        wm8904_write_reg(WM8904_CLOCK_RATES_2, (1 << 1) | (1 << 2) | (1 << 14));
        k_msleep(1);
    }
}*/

void init_wm8904_codec()
{
    // https://github.com/avrxml/asf/blob/master/sam/components/audio/codec/wm8904/example/wm8904_example.c
    if (device_is_ready(i2c_dev))
    {
        // Reset the device, making sure CLK_SYS_ENA = 0. From the datasheet:
        // Note that, if it cannot be assured that MCLK is present when accessing
        // the register map, then it is required to set CLK_SYS_ENA = 0 to
        // ensure correct operation.
        wm8904_write_reg(WM8904_SW_RESET_AND_ID, 0);

        uint32_t device_id = wm8904_read_reg(WM8904_SW_RESET_AND_ID);
        __ASSERT(device_id == 0x8904, "Failed to read wm8904 device id");

        // wm8904_write_register(WM8904_BIAS_CONTROL_0, WM8904_ISEL_HP_BIAS);
        wm8904_write_reg(WM8904_BIAS_CONTROL_0, 0b1000);

        // wm8904_write_register(WM8904_VMID_CONTROL_0, WM8904_VMID_BUF_ENA |
        //     					 WM8904_VMID_RES_FAST | WM8904_VMID_ENA);
        wm8904_write_reg(WM8904_VMID_CONTROL_0, 0b1000111);
        k_msleep(5);
        // wm8904_write_register(WM8904_VMID_CONTROL_0, WM8904_VMID_BUF_ENA |
        //    					 WM8904_VMID_RES_NORMAL | WM8904_VMID_ENA);
        wm8904_write_reg(WM8904_VMID_CONTROL_0, 0b1000011);
        // wm8904_write_register(WM8904_BIAS_CONTROL_0, WM8904_ISEL_HP_BIAS | WM8904_BIAS_ENA);
        wm8904_write_reg(WM8904_BIAS_CONTROL_0, 0b11001);
        // wm8904_write_register(WM8904_POWER_MANAGEMENT_0, WM8904_INL_ENA | WM8904_INR_ENA);
        wm8904_write_reg(WM8904_POWER_MANAGEMENT_0, 0b11);
        // wm8904_write_register(WM8904_POWER_MANAGEMENT_2, WM8904_HPL_PGA_ENA | WM8904_HPR_PGA_ENA);
        wm8904_write_reg(WM8904_POWER_MANAGEMENT_2, 0b11);
        // wm8904_write_register(WM8904_DAC_DIGITAL_1, WM8904_DEEMPH(0));
        wm8904_write_reg(WM8904_DAC_DIGITAL_1, 0b0);
        // wm8904_write_register(WM8904_ANALOGUE_OUT12_ZC, 0x0000);
        wm8904_write_reg(WM8904_ANALOGUE_OUT12_ZC, 0b0);
        // wm8904_write_register(WM8904_CHARGE_PUMP_0, WM8904_CP_ENA);
        wm8904_write_reg(WM8904_CHARGE_PUMP_0, 0b1);
        // wm8904_write_register(WM8904_CLASS_W_0, WM8904_CP_DYN_PWR);
        wm8904_write_reg(WM8904_CLASS_W_0, 0b1);

        // wm8904_write_register(WM8904_FLL_CONTROL_1, 0x0000);
        // wm8904_write_register(WM8904_FLL_CONTROL_1, WM8904_FLL_FRACN_ENA | WM8904_FLL_ENA);
        // wm8904_write_register(WM8904_FLL_CONTROL_2, WM8904_FLL_OUTDIV(7)| WM8904_FLL_FRATIO(4));
        wm8904_write_reg(WM8904_FLL_CONTROL_2, 8 << 8);
        // wm8904_write_register(WM8904_FLL_CONTROL_3, WM8904_FLL_K(0x8000));
        wm8904_write_reg(WM8904_FLL_CONTROL_3, 0x0);
        // wm8904_write_register(WM8904_FLL_CONTROL_4, WM8904_FLL_N(0xBB));
        wm8904_write_reg(WM8904_FLL_CONTROL_4, 32 << 5); //
        // WM8904_FLL_CONTROL_5
        wm8904_write_reg(WM8904_FLL_CONTROL_5, 0b1); // use bitckl as FLL reference
        wm8904_write_reg(WM8904_FLL_CONTROL_1, 0b001); // ENABLE FLL  FRACN_ENA true
        k_msleep(5);

        // wm8904_write_register(WM8904_CLOCK_RATES_0, 0x0000);
        wm8904_write_reg(WM8904_CLOCK_RATES_0, 0b0);
        // wm8904_write_register(WM8904_CLOCK_RATES_1, WM8904_CLK_SYS_RATE(3) | WM8904_SAMPLE_RATE(5));
        wm8904_write_reg(WM8904_CLOCK_RATES_1, 0b101 | (0b11 << 10)); // sysclk = 256fs, fs =~ 44.1 khz
        // wm8904_write_register(WM8904_CLOCK_RATES_2,
        //           		     WM8904_SYSCLK_SRC | WM8904_CLK_SYS_ENA | WM8904_CLK_DSP_ENA);
        // wm8904_write_reg(WM8904_CLOCK_RATES_2, (1 << 1) | (1 << 14)); // sysclk src = pll, disable sysclock
        // wm8904_write_register(WM8904_AUDIO_INTERFACE_1, WM8904_BCLK_DIR | WM8904_AIF_FMT_I2S);
        const int word_len = (0b10 << 2); // 24 bit
        wm8904_write_reg(WM8904_AUDIO_INTERFACE_1, 0b10 | word_len);
        // wm8904_write_register(WM8904_AUDIO_INTERFACE_2, WM8904_BCLK_DIV(8));
        // wm8904_write_reg(WM8904_AUDIO_INTERFACE_2, 0b0100); // <- master only?
        // wm8904_write_register(WM8904_AUDIO_INTERFACE_3, WM8904_LRCLK_DIR | WM8904_LRCLK_RATE(0x20)); // <- master only?
        // wm8904_write_reg(0x1b, xxx);
        // wm8904_write_register(WM8904_POWER_MANAGEMENT_6,
        // 	         			 WM8904_DACL_ENA | WM8904_DACR_ENA |
        // 				WM8904_ADCL_ENA | WM8904_ADCR_ENA);
        wm8904_write_reg(WM8904_POWER_MANAGEMENT_6, 0b1111);
        k_msleep(5);

        // wm8904_write_register(WM8904_ANALOGUE_LEFT_INPUT_0, WM8904_LIN_VOL(0x10));
        // wm8904_write_register(WM8904_ANALOGUE_RIGHT_INPUT_0, WM8904_RIN_VOL(0x10));

        // wm8904_write_register(WM8904_ANALOGUE_HP_0,
        // 				WM8904_HPL_ENA | WM8904_HPR_ENA);
        wm8904_write_reg(WM8904_ANALOGUE_HP_0, 0b10001);
        wm8904_write_reg(WM8904_ANALOGUE_LINEOUT_0, 0b10001);
        k_msleep(1);
        // wm8904_write_register(WM8904_ANALOGUE_HP_0,
        // 				WM8904_HPL_ENA_DLY | WM8904_HPL_ENA |
        // 				WM8904_HPR_ENA_DLY | WM8904_HPR_ENA);
        wm8904_write_reg(WM8904_ANALOGUE_HP_0, 0b110011);
        wm8904_write_reg(WM8904_ANALOGUE_LINEOUT_0, 0b110011);

        // wm8904_write_register(WM8904_DC_SERVO_0,
        // WM8904_DCS_ENA_CHAN_3 | WM8904_DCS_ENA_CHAN_2 |
        // WM8904_DCS_ENA_CHAN_1 | WM8904_DCS_ENA_CHAN_0);
        wm8904_write_reg(WM8904_DC_SERVO_0, 0b1111);
        // wm8904_write_register(WM8904_DC_SERVO_1,
        // 			WM8904_DCS_TRIG_STARTUP_3 | WM8904_DCS_TRIG_STARTUP_2 |
        // 		WM8904_DCS_TRIG_STARTUP_1 | WM8904_DCS_TRIG_STARTUP_0);
        wm8904_write_reg(WM8904_DC_SERVO_1, (1 << 4) | (1 << 5) | (1 << 6) | (1 << 7));
        k_msleep(100);
        // wm8904_write_register(WM8904_ANALOGUE_HP_0,
        // 			WM8904_HPL_ENA_OUTP | WM8904_HPL_ENA_DLY | WM8904_HPL_ENA |
        // 		WM8904_HPR_ENA_OUTP | WM8904_HPR_ENA_DLY | WM8904_HPR_ENA);
        wm8904_write_reg(WM8904_ANALOGUE_HP_0, 0b1110111);
        wm8904_write_reg(WM8904_ANALOGUE_LINEOUT_0, 0b1110111);

        // wm8904_write_register(WM8904_ANALOGUE_HP_0,
        // 			WM8904_HPL_RMV_SHORT | WM8904_HPL_ENA_OUTP | WM8904_HPL_ENA_DLY | WM8904_HPL_ENA |
        // 		WM8904_HPR_RMV_SHORT | WM8904_HPR_ENA_OUTP | WM8904_HPR_ENA_DLY | WM8904_HPR_ENA);
        wm8904_write_reg(WM8904_ANALOGUE_HP_0, 0b11111111);
        wm8904_write_reg(WM8904_ANALOGUE_LINEOUT_0, 0b11111111);

        // wm8904_write_register(WM8904_ANALOGUE_OUT1_LEFT, WM8904_HPOUT_VU | WM8904_HPOUTL_VOL(0x39));
        // wm8904_write_register(WM8904_ANALOGUE_OUT1_RIGHT, WM8904_HPOUT_VU | WM8904_HPOUTR_VOL(0x39));
        wm8904_write_reg(WM8904_ANALOGUE_OUT1_LEFT, 0b111001 | (1 << 7));
        wm8904_write_reg(WM8904_ANALOGUE_OUT1_RIGHT, 0b111001 | (1 << 7));
        wm8904_write_reg(WM8904_ANALOGUE_OUT2_LEFT, 0b111001 | (1 << 7));
        wm8904_write_reg(WM8904_ANALOGUE_OUT2_RIGHT, 0b111001 | (1 << 7));

        k_msleep(100);
        // sysclk src = pll, enable sys clk, enable dsp clk
        wm8904_write_reg(WM8904_CLOCK_RATES_2, (1 << 1) | (1 << 2) | (1 << 14));
    }
}
```

## src/codec.h
```c
#ifndef AUDIO_CODEC_H
#define AUDIO_CODEC_H

void init_wm8758b_codec();
void init_wm8904_codec();

#endif
```

## src/i2s.c
```c
#include "i2s.h"
#include <zephyr.h>
#include <zephyr/kernel/thread.h>

/***********************************************************
 * Audio buffers
 ***********************************************************/
#define AUDIO_BUFFER_N_FRAMES 256
#define AUDIO_BUFFER_N_CHANNELS 2
#define BYTES_PER_SAMPLE 4 /* 24 bit samples are transfered in 32 bit words */
#define AUDIO_BUFFER_N_SAMPLES (AUDIO_BUFFER_N_FRAMES * AUDIO_BUFFER_N_CHANNELS)
#define AUDIO_BUFFER_BYTE_SIZE (BYTES_PER_SAMPLE * AUDIO_BUFFER_N_SAMPLES)
#define AUDIO_BUFFER_WORD_SIZE (AUDIO_BUFFER_BYTE_SIZE / 4)

/* Floating point mono scratch buffers. */
static float scratch_buffer_out[AUDIO_BUFFER_N_FRAMES];
static float scratch_buffer_in[AUDIO_BUFFER_N_FRAMES];

/* Use two pairs of rx/tx buffers for double buffering,
   i.e process/render one pair of buffers while the other is
   being received/transfered. */
static int32_t __attribute__((aligned(4))) rx_1[AUDIO_BUFFER_N_SAMPLES];
static int32_t __attribute__((aligned(4))) tx_1[AUDIO_BUFFER_N_SAMPLES];
static int32_t __attribute__((aligned(4))) rx_2[AUDIO_BUFFER_N_SAMPLES];
static int32_t __attribute__((aligned(4))) tx_2[AUDIO_BUFFER_N_SAMPLES];
nrfx_i2s_buffers_t nrfx_i2s_buffers_1 = {
    .p_rx_buffer = (uint32_t *)(&rx_1), .p_tx_buffer = (uint32_t *)(&tx_1)
};
nrfx_i2s_buffers_t nrfx_i2s_buffers_2 = {
    .p_rx_buffer = (uint32_t *)(&rx_2), .p_tx_buffer = (uint32_t *)(&tx_2)
};

/***********************************************************
 * Audio processing synchronization
 ***********************************************************/
/* Flag indicating which buffer pair is currently available for
   processing/rendering. */
static int processing_buffers_1 = 0;
/* A semaphore used to trigger audio processing on a dedicated thread
   from the I2S interrupt handler. */
K_SEM_DEFINE(processing_thread_semaphore, 0, 1);
/* Indicates if the current buffer pair is being processed/rendered. */
atomic_t processing_in_progress = ATOMIC_INIT(0x00);
/* Indicates if a dropout occurred, i.e that audio buffers were
   not processed in time for the next buffer swap. */
atomic_t dropout_occurred = ATOMIC_INIT(0x00);

/***********************************************************
 * Audio processing thread
 ***********************************************************/
#define PROCESSING_THREAD_STACK_SIZE 2048
/* Processing thread is a top priority cooperative thread */
#define PROCESSING_THREAD_PRIORITY -CONFIG_NUM_COOP_PRIORITIES
K_THREAD_STACK_DEFINE(processing_thread_stack_area, PROCESSING_THREAD_STACK_SIZE);
struct k_thread processing_thread_data;

uint32_t processing_sem_give_time = 0;

static void processing_thread_entry_point(void *p1, void *p2, void *p3) {
    while (true) {
        if (k_sem_take(&processing_thread_semaphore, K_FOREVER) == 0) {
            audio_callbacks_t* audio_callbacks = (audio_callbacks_t*)p1;
            if (atomic_test_bit(&dropout_occurred, 0)) {
                audio_callbacks->dropout_cb(audio_callbacks->cb_data);
                atomic_clear_bit(&dropout_occurred, 0);
            }
            uint32_t processing_sem_take_time = k_cycle_get_32();
            uint32_t cycles_spent = processing_sem_take_time - processing_sem_give_time;
            uint32_t ns_spent = k_cyc_to_ns_ceil32(cycles_spent);
            /* printk("processing thread start took %d ns\n", ns_spent); */

            if (!atomic_test_bit(&processing_in_progress, 0)) {
                printk("processing_in_progress is not set");
                __ASSERT(atomic_test_bit(&processing_in_progress, 0), "processing_in_progress is not set");
            }

            nrfx_i2s_buffers_t* buffers_to_process = processing_buffers_1 ? &nrfx_i2s_buffers_1 : &nrfx_i2s_buffers_2;
            int32_t *tx = (int32_t *)buffers_to_process->p_tx_buffer;
            int32_t *rx = (int32_t *)buffers_to_process->p_rx_buffer;

            /* Convert incoming audio from PCM, discarding right channel */
            float max_sq = 0.0;
            for (int i = 0; i < AUDIO_BUFFER_N_FRAMES; i++) {
                int32_t rx_l = rx[2 * i];
                float val_f = rx_l / (float)8388607.0;
                scratch_buffer_in[i] = val_f;
            }

            /* Process audio using the proved callback */
            memset(scratch_buffer_out, 0, AUDIO_BUFFER_N_FRAMES * sizeof(float));
            audio_callbacks->processing_cb(
                audio_callbacks->cb_data,
                AUDIO_BUFFER_N_FRAMES,
                scratch_buffer_out,
                scratch_buffer_in
            );

            /* Convert outgoing audio to PCM */
            int32_t tx_min = 0;
            int32_t tx_max = 0;
            for (int i = 0; i < AUDIO_BUFFER_N_FRAMES; i++) {
                int32_t tx_curr = scratch_buffer_out[i] * 8388607.0f;
                tx[2 * i] = tx_curr;
                tx[2 * i + 1] = tx_curr;
            }

            /* Swap buffers */
            nrfx_err_t result = nrfx_i2s_next_buffers_set(buffers_to_process);
            if (result != NRFX_SUCCESS) {
                /* printk("nrfx_i2s_next_buffers_set failed with %d\n", result); */
                __ASSERT(result == NRFX_SUCCESS, "nrfx_i2s_next_buffers_set failed with result %d", result);
            }
            processing_buffers_1 = !processing_buffers_1;

            /* Done processing */
            atomic_clear_bit(&processing_in_progress, 0);
        }
    }
}

ISR_DIRECT_DECLARE(i2s_isr_handler)
{
    nrfx_i2s_irq_handler();
    ISR_DIRECT_PM();
    return 1;
}

void nrfx_i2s_data_handler(nrfx_i2s_buffers_t const *p_released, uint32_t status)
{
    if (status == NRFX_I2S_STATUS_NEXT_BUFFERS_NEEDED) {
        if (atomic_test_bit(&processing_in_progress, 0) == false) {
            atomic_set_bit(&processing_in_progress, 0);
            processing_sem_give_time = k_cycle_get_32();
            k_sem_give(&processing_thread_semaphore);
        } else {
            /* Missed deadline! */
            atomic_set_bit(&dropout_occurred, 0);
        }
    }
    else if (status == NRFX_I2S_STATUS_TRANSFER_STOPPED) {
        /* */
    }
}

nrfx_err_t i2s_start(i2s_pin_cfg_t* pin_cfg, audio_callbacks_t* audio_callbacks)
{
    /* Start a dedicated, high priority thread for audio processing. */
    k_tid_t processing_thread_tid = k_thread_create(
        &processing_thread_data,
        processing_thread_stack_area,
        K_THREAD_STACK_SIZEOF(processing_thread_stack_area),
        processing_thread_entry_point,
        audio_callbacks, NULL, NULL,
        PROCESSING_THREAD_PRIORITY, 0, K_NO_WAIT
    );

    /* Init and start I2S */
    IRQ_DIRECT_CONNECT(NRFX_IRQ_NUMBER_GET(NRF_I2S0), 0, i2s_isr_handler, 0);

    nrfx_i2s_config_t nrfx_i2s_cfg = {
        .sck_pin = pin_cfg->sck_pin,
        .lrck_pin = pin_cfg->lrck_pin,
        .mck_pin = pin_cfg->mck_pin,
        .sdout_pin = pin_cfg->sdout_pin,
        .sdin_pin = pin_cfg->sdin_pin,
        .mck_setup = NRF_I2S_MCK_32MDIV15,
        .ratio = NRF_I2S_RATIO_48X,
        .irq_priority = NRFX_I2S_DEFAULT_CONFIG_IRQ_PRIORITY,
        .mode = NRF_I2S_MODE_MASTER,
        .format = NRF_I2S_FORMAT_I2S,
        .alignment = NRF_I2S_ALIGN_LEFT,
        .channels = NRF_I2S_CHANNELS_STEREO,
        .sample_width = NRF_I2S_SWIDTH_24BIT
    };

    nrfx_err_t result = nrfx_i2s_init(&nrfx_i2s_cfg, &nrfx_i2s_data_handler);
    if (result != NRFX_SUCCESS) {
        printk("nrfx_i2s_init failed with result %d", result);
        __ASSERT(result == NRFX_SUCCESS, "nrfx_i2s_init failed with result %d", result);
        return result;
    }

    result = nrfx_i2s_start(&nrfx_i2s_buffers_1, AUDIO_BUFFER_WORD_SIZE, 0);
    if (result != NRFX_SUCCESS) {
        printk("nrfx_i2s_start failed with result %d", result);
        __ASSERT(result == NRFX_SUCCESS, "nrfx_i2s_start failed with result %d", result);
        return result;
    }

    return NRFX_SUCCESS;
}
```

## src/i2s.h
```c
#ifndef I2S_H
#define I2S_H

#include <nrfx_i2s.h>
#include "audio_callbacks.h"

typedef struct {
    uint8_t sck_pin;
    uint8_t lrck_pin;
    uint8_t mck_pin;
    uint8_t sdout_pin;
    uint8_t sdin_pin;
} i2s_pin_cfg_t;

nrfx_err_t i2s_start(i2s_pin_cfg_t* pin_cfg, audio_callbacks_t* audio_callbacks);

#endif
```

## src/i2s_nrfx.c
```c
#include "i2s_nrfx.h"
#include <zephyr.h>
#include <zephyr/kernel/thread.h>

////////////////////////////////////////////////////////////
// Audio buffers
////////////////////////////////////////////////////////////
#define AUDIO_BUFFER_N_FRAMES 256
#define AUDIO_BUFFER_N_CHANNELS 2
#define BYTES_PER_SAMPLE 4 // 24 bit samples are transfered in 32 bit words
#define AUDIO_BUFFER_N_SAMPLES (AUDIO_BUFFER_N_FRAMES * AUDIO_BUFFER_N_CHANNELS)
#define AUDIO_BUFFER_BYTE_SIZE (BYTES_PER_SAMPLE * AUDIO_BUFFER_N_SAMPLES)
#define AUDIO_BUFFER_WORD_SIZE (AUDIO_BUFFER_BYTE_SIZE / 4)

// Floating point scratch buffers.
static float scratch_buffer_out[AUDIO_BUFFER_N_SAMPLES];
static float scratch_buffer_in[AUDIO_BUFFER_N_SAMPLES];

// Use two pairs of rx/tx buffers for double buffering,
// i.e process/render one pair of buffers while the other is
// being transfered.
static int32_t __attribute__((aligned(4))) rx_1[AUDIO_BUFFER_N_SAMPLES];
static int32_t __attribute__((aligned(4))) tx_1[AUDIO_BUFFER_N_SAMPLES];
static int32_t __attribute__((aligned(4))) rx_2[AUDIO_BUFFER_N_SAMPLES];
static int32_t __attribute__((aligned(4))) tx_2[AUDIO_BUFFER_N_SAMPLES];
nrfx_i2s_buffers_t nrfx_i2s_buffers_1 = {
    .p_rx_buffer = (uint32_t *)(&rx_1), .p_tx_buffer = (uint32_t *)(&tx_1)
};
nrfx_i2s_buffers_t nrfx_i2s_buffers_2 = {
    .p_rx_buffer = (uint32_t *)(&rx_2), .p_tx_buffer = (uint32_t *)(&tx_2)
};

////////////////////////////////////////////////////////////
// Audio processing synchronization
////////////////////////////////////////////////////////////
// Flag indicating which buffer pair is currently available for
// processing/rendering.
static int processing_buffers_1 = 0;
// A semaphore used to trigger audio processing on a dedicated thread
// from the I2S interrupt handler.
K_SEM_DEFINE(processing_thread_semaphore, 0, 1);
// Indicates if the current buffer pair is being processed/rendered.
atomic_t processing_in_progress = ATOMIC_INIT(0x00);
// Indicates if a dropout occurred, i.e that audio buffers were
// not processed in time for the next buffer swap.
atomic_t dropout_occurred = ATOMIC_INIT(0x00);

////////////////////////////////////////////////////////////
// Audio processing thread
////////////////////////////////////////////////////////////
#define PROCESSING_THREAD_STACK_SIZE 2048
// Processing thread is a top priority cooperative thread
#define PROCESSING_THREAD_PRIORITY -CONFIG_NUM_COOP_PRIORITIES
K_THREAD_STACK_DEFINE(processing_thread_stack_area, PROCESSING_THREAD_STACK_SIZE);
struct k_thread processing_thread_data;

uint32_t processing_sem_give_time = 0;

static void processing_thread_entry_point(void *p1, void *p2, void *p3) {
    while (true) {
        if (k_sem_take(&processing_thread_semaphore, K_FOREVER) == 0) {
            audio_processing_options_t* processing_options = (audio_processing_options_t*)p1;
            if (atomic_test_bit(&dropout_occurred, 0)) {
                processing_options->dropout_cb(processing_options);
            }
            uint32_t processing_sem_take_time = k_cycle_get_32();
            uint32_t cycles_spent = processing_sem_take_time - processing_sem_give_time;
            uint32_t ns_spent = k_cyc_to_ns_ceil32(cycles_spent);
            // printk("processing thread start took %d ns\n", ns_spent);

            if (!atomic_test_bit(&processing_in_progress, 0)) {
                printk("processing_in_progress is not set");
                __ASSERT(atomic_test_bit(&processing_in_progress, 0), "processing_in_progress is not set");
            }

            nrfx_i2s_buffers_t* buffers_to_process = processing_buffers_1 ? &nrfx_i2s_buffers_1 : &nrfx_i2s_buffers_2;
            // TODO: not always int32_t
            int32_t *tx = (int32_t *)buffers_to_process->p_tx_buffer;
            int32_t *rx = (int32_t *)buffers_to_process->p_rx_buffer;

            // Convert incoming audio from PCM
            for (int i = 0; i < AUDIO_BUFFER_N_SAMPLES; i++) {
                scratch_buffer_in[i] = rx[i] / 8388607.0;
            }

            memset(scratch_buffer_out, 0, AUDIO_BUFFER_N_SAMPLES * sizeof(float));
            processing_options->processing_cb(
                processing_options->processing_cb_data,
                AUDIO_BUFFER_N_FRAMES,
                AUDIO_BUFFER_N_CHANNELS,
                scratch_buffer_out,
                scratch_buffer_in
            );

            // Convert outgoing audio to PCM
            for (int i = 0; i < AUDIO_BUFFER_N_SAMPLES; i++) {
                tx[i] = scratch_buffer_out[i] * 8388607.0; // TODO: saturated?
            }

            nrfx_i2s_buffers_t* buffers_to_set = processing_buffers_1 ? &nrfx_i2s_buffers_2 : &nrfx_i2s_buffers_1;
            nrfx_err_t result = nrfx_i2s_next_buffers_set(buffers_to_process);
            if (result != NRFX_SUCCESS) {
                printk("nrfx_i2s_next_buffers_set failed with %d\n", result);
                __ASSERT(result == NRFX_SUCCESS, "nrfx_i2s_next_buffers_set failed with result %d", result);
            }

            processing_buffers_1 = !processing_buffers_1;

            atomic_clear_bit(&processing_in_progress, 0);
        }
    }
}

const uint8_t lrck_pin = 29; // 29; // P0.29 7 aka word select
const uint8_t sdout_pin = 30; // 30; // P0.30 25
const uint8_t sck_pin = 4;  // 31; // aka bitcklock P0.31 26
const uint8_t mck_pin = NRFX_I2S_PIN_NOT_USED; // 31;   // 27; // NRFX_I2S_PIN_NOT_USED;
const uint8_t sdin_pin = 28; // NRFX_I2S_PIN_NOT_USED; // 6; // NRFX_I2S_PIN_NOT_USED;

nrfx_i2s_config_t nrfx_i2s_cfg = {
    .sck_pin = sck_pin,
    .lrck_pin = lrck_pin,
    .mck_pin = mck_pin,
    .sdout_pin = sdout_pin,
    .sdin_pin = sdin_pin,
    .irq_priority = NRFX_I2S_DEFAULT_CONFIG_IRQ_PRIORITY,
    .mode = NRF_I2S_MODE_MASTER,
    .format = NRF_I2S_FORMAT_I2S,
    .alignment = NRF_I2S_ALIGN_LEFT,
    .channels = NRF_I2S_CHANNELS_STEREO,
    .sample_width = NRF_I2S_SWIDTH_24BIT,
    .mck_setup = NRF_I2S_MCK_32MDIV15,
    .ratio = NRF_I2S_RATIO_48X,
};

ISR_DIRECT_DECLARE(i2s_isr_handler)
{
    nrfx_i2s_irq_handler();
    // PM done after servicing interrupt for best latency
    ISR_DIRECT_PM();
    // We should check if scheduling decision should be made
    return 1;
}

void nrfx_i2s_data_handler(nrfx_i2s_buffers_t const *p_released, uint32_t status)
{
    if (status == NRFX_I2S_STATUS_NEXT_BUFFERS_NEEDED) {
        if (atomic_test_bit(&processing_in_progress, 0) == false) {
            atomic_set_bit(&processing_in_progress, 0);
            processing_sem_give_time = k_cycle_get_32();
            k_sem_give(&processing_thread_semaphore);
        } else {
            // Missed deadline.
            atomic_set_bit(&dropout_occurred, 0);
        }
    }
    else if (status == NRFX_I2S_STATUS_TRANSFER_STOPPED) {
        //
    }
}

nrfx_err_t i2s_start(audio_processing_options_t* processing_options)
{
    // Start a dedicated, high priority thread for audio processing.
    k_tid_t processing_thread_tid = k_thread_create(
        &processing_thread_data,
        processing_thread_stack_area,
        K_THREAD_STACK_SIZEOF(processing_thread_stack_area),
        processing_thread_entry_point,
        processing_options, NULL, NULL,
        PROCESSING_THREAD_PRIORITY, 0, K_NO_WAIT
    );

    IRQ_DIRECT_CONNECT(NRFX_IRQ_NUMBER_GET(NRF_I2S), 0, i2s_isr_handler, 0);

    // Init and start I2S
    nrfx_err_t result = nrfx_i2s_init(&nrfx_i2s_cfg, &nrfx_i2s_data_handler);
    if (result != NRFX_SUCCESS) {
        printk("nrfx_i2s_init failed with result %d", result);
        __ASSERT(result == NRFX_SUCCESS, "nrfx_i2s_init failed with result %d", result);
    }

    result = nrfx_i2s_start(&nrfx_i2s_buffers_1, AUDIO_BUFFER_WORD_SIZE, 0);
    if (result != NRFX_SUCCESS) {
        printk("nrfx_i2s_start failed with result %d", result);
        __ASSERT(result == NRFX_SUCCESS, "nrfx_i2s_start failed with result %d", result);
    }

    return NRFX_SUCCESS; // TODO: return proper result
}
```

## src/i2s_nrfx.h
```c
#ifndef NRF_I2S_H
#define NRF_I2S_H

#include <nrfx_i2s.h>
#include "audio_processing.h"

nrfx_err_t i2s_start(audio_processing_options_t* processing_options);

#endif
```

## src/leds.c
```c
#ifndef LEDS_H
#define LEDS_H

#include <zephyr/drivers/gpio.h>
#include "leds.h"

#define LED0_NODE DT_ALIAS(led0)
#define LED1_NODE DT_ALIAS(led1)
#define LED2_NODE DT_ALIAS(led2)
#define LED3_NODE DT_ALIAS(led3)

static const struct gpio_dt_spec leds[4] = {
    GPIO_DT_SPEC_GET(LED0_NODE, gpios),
    GPIO_DT_SPEC_GET(LED1_NODE, gpios),
    GPIO_DT_SPEC_GET(LED2_NODE, gpios),
    GPIO_DT_SPEC_GET(LED3_NODE, gpios),
};

int init_leds()
{
    for (uint32_t i = 0; i < 4; i++)
    {
        gpio_pin_configure_dt(&leds[i], GPIO_OUTPUT_ACTIVE);
	    gpio_pin_set_dt(&leds[i], 0);
    }
}

int set_led_state(int led_index, int is_on)
{
    if (led_index >= 0 || led_index < 4) {
        gpio_pin_set_dt(&leds[led_index], is_on);
    }
}

#endif
```
